## conf/layer.conf
```bitbake
# We have a conf and classes directory, add to BBPATH
BBPATH .= ":${LAYERDIR}"

# We have recipes-* directories, add to BBFILES
BBFILES += "${LAYERDIR}/recipes-*/*/*.bb \
            ${LAYERDIR}/recipes-*/*/*.bbappend"

BBFILE_COLLECTIONS += "meta-fvc"
BBFILE_PATTERN_meta-fvc = "^${LAYERDIR}/"
BBFILE_PRIORITY_meta-fvc = "8"

LAYERDEPENDS_meta-fvc = "core"
LAYERSERIES_COMPAT_meta-fvc = "kirkstone"
```

## conf/machine/celeritas.conf
```bitbake
#@TYPE: Machine
#@NAME: i.MX 8QXP B0 Celeritas
#@DESCRIPTION: i.MX 8QuadXPlus B0 Celeritas Board
#

require conf/machine/include/imx-base.inc
require conf/machine/include/arm/armv8a/tune-cortexa35.inc

IMX_DEFAULT_BSP = "nxp"

MACHINE_FEATURES += "pci optee bcm43455 bcm4356"
MACHINE_FEATURES:append:use-nxp-bsp = " bcm4359"

# Don't include kernels in standard images
RRECOMMENDS:${KERNEL_PACKAGE_NAME}-base = ""

LOADADDR = ""

# We have to disable SERIAL_CONSOLE due to auto-serial-console
SERIAL_CONSOLES = "115200;ttyAMA0"

# we do not want to have getty running on tty1 as we run
# auto-serial-console there
USE_VT = "0"

KERNEL_DEVICETREE = " \
    freescale/${KERNEL_DEVICETREE_BASENAME}.dtb \
"

KERNEL_DEVICETREE:append:use-nxp-bsp = " \
    freescale/imx8qxp-celeritas-rpmsg.dtb \
"


UBOOT_MAKE_TARGET = \
    "${@bb.utils.contains('MACHINE_FEATURES', 'optee', '', \
                                                       'u-boot.bin', d)}"
SPL_BINARY = \
    "${@bb.utils.contains('MACHINE_FEATURES', 'optee', 'spl/u-boot-spl.bin', \
                                                       '', d)}"

UBOOT_CONFIG ??= "sd"
UBOOT_CONFIG[sd]   = "${UBOOT_CONFIG_BASENAME}_defconfig,sdcard"

IMX_BOOT_SEEK = "32"

# This machine is not supported by u-boot-fslc, so we force it to use
# u-boot-imx here.
IMX_DEFAULT_BOOTLOADER = "u-boot-imx"
UBOOT_SUFFIX = "bin"
unset IMXBOOT_TARGETS_SD
unset IMXBOOT_TARGETS
unset IMXBOOT_TARGETS_FSPI

IMXBOOT_TARGETS_SD = "${@bb.utils.contains('MACHINE_FEATURES', 'optee', 'flash_spl', \
                                                       'flash', d)}"

IMXBOOT_TARGETS = "${@bb.utils.contains('UBOOT_CONFIG',        'sd', '${IMXBOOT_TARGETS_SD}', \
                                                       '${IMXBOOT_TARGETS_SD}', d)}"
BOARD_TYPE = "mek"

# Add additional firmware
MACHINE_FIRMWARE:append = " linux-firmware-ath10k"


MACHINEOVERRIDES =. "mx8qxp:"


KERNEL_DEVICETREE_BASENAME = "${MACHINE}"
UBOOT_CONFIG_BASENAME = "imx8qxp_celeritas"

ATF_PLATFORM = "imx8qx"

IMX_BOOT_SOC_TARGET = "iMX8QX"

MACHINEOVERRIDES =. "imx8qxp-celeritas:"
KERNEL_DEVICETREE_BASENAME = "imx8qxp-celeritas"

# Make it Rev B0
MACHINE_FEATURES += "soc-revb0"

IMAGE_FSTYPES += "wic"

#IMAGE_ROOTFS_SIZE = "3670016"
WKS_FILE = "celeritas-imx-boot-bootpart.wks.in"
#UBOOT_DTB_NAME = "imx8qxp-celeritas.dtb"
```
